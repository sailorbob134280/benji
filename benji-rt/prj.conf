## CMakeLists.txt
```
cmake_minimum_required(VERSION 3.20.0)
find_package(Zephyr REQUIRED HINTS $ENV{ZEPHYR_BASE})
project(benji-rt)

target_sources(app PRIVATE src/main.c)
```

## prj.conf
```kconfig
CONFIG_LOG=y
CONFIG_LOG_BUFFER_SIZE=2048
CONFIG_LOG_PRINTK=y
CONFIG_LOG_SPEED=y

CONFIG_SENSOR=y

CONFIG_CPP=y
CONFIG_STD_CPP23=y
CONFIG_REQUIRES_FULL_LIBCPP=y
```

## src/main.c
```c
#include <zephyr/kernel.h>

#define HELLO_INTERVAL_MS 1000

int main() {
  for (;;) {
    printk("Hello, world!\r\n");

    k_msleep(HELLO_INTERVAL_MS);
  }

  return 0;
}
```
